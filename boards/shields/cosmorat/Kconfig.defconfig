## boards/shields/cosmorat/Kconfig.defconfig
```kconfig
if SHIELD_NOZHIKLAVA_LEFT
    config ZMK_SPLIT_ROLE_CENTRAL
        default y
endif
```

## boards/shields/cosmorat/Kconfig.shield
```kconfig
config SHIELD_NOZHIKLAVA_LEFT
	def_bool $(shields_list_contains,nozhiklava_left)

config SHIELD_NOZHIKLAVA_RIGHT
	def_bool $(shields_list_contains,nozhiklava_right)
```
